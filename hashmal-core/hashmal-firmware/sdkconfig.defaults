## hashmal-core/hashmal-firmware/sdkconfig.defaults
```kconfig
# ═══════════════════════════════════════════════════════════════════
# CIMIENTO 00 — sdkconfig.defaults
# "Conforme a TODO lo que Yo te muestro" — Éxodo 25:9
# ═══════════════════════════════════════════════════════════════════

# ── Target ──
CONFIG_IDF_TARGET="esp32s3"

# ── Bluetooth — paʻamón (Éx 28:34) — campanilla BLE ──
CONFIG_BT_ENABLED=y
CONFIG_BT_NIMBLE_ENABLED=y
CONFIG_BT_CONTROLLER_ENABLED=y
CONFIG_BT_CONTROLLER_MODE_BLE_ONLY=y

# ── WiFi — ishá el ajotá (Éx 26:3) — para ESP-NOW ──
CONFIG_ESP_WIFI_ENABLED=y

# ── LoRa SPI — yaréj (Éx 25:31) — bus SPI para SX1262 ──
CONFIG_SPI_MASTER_IN_IRAM=y

# ── Flash — Arca del Testimonio (Éx 25:16) ──
CONFIG_PARTITION_TABLE_CUSTOM=y
CONFIG_PARTITION_TABLE_CUSTOM_FILENAME="partitions.csv"
CONFIG_ESPTOOLPY_FLASHSIZE_16MB=y

# ── Seguridad — Velo (Éx 26:31-33) ──
CONFIG_ESP_TLS_USING_MBEDTLS=y

# ── Timer — tamíd (Éx 27:20) ──
CONFIG_ESP_TIMER_TASK_STACK_SIZE=4096

# ── Log level ──
CONFIG_LOG_DEFAULT_LEVEL_INFO=y

# ── HTTP Server — SHA'AR HA'ATRIO (Éx 27:16) ──
# Android captive portal browser manda cabeceras largas (User-Agent > 200 bytes).
# Default 512 → "Header fields are too long". 2048 cubre todos los navegadores.
CONFIG_HTTPD_MAX_REQ_HDR_LEN=2048
CONFIG_HTTPD_MAX_URI_LEN=512

# ── LWIP Sockets — 60 COLUMNAS DEL ATRIO (Éx 27:9-19) ──
# El Padre puso 60 columnas en el atrio (Detalle 4, Pieza 07).
# "No midas el atrio exterior" — Ap 11:2 — la frontera es flexible.
# 16 sockets LWIP → 13 usables por el HTTP server (16-3 internos).
# Default 10 → 7 usables: insuficiente con 4 teléfonos (errno 23).
CONFIG_LWIP_MAX_SOCKETS=16
```
